## target/linux/ls1bdev/image/Config.in
```kconfig
config LS_GRUB_IMAGES
    bool "Build GRUB images "
    depends TARGET_ROOTFS_EXT2FS || TARGET_ROOTFS_JFFS2 || TARGET_ROOTFS_SQUASHFS || TARGET_ROOTFS_ISO
	depends TARGET_godson2f_firewall
    default y

config LS_GRUB_IMAGES_PAD
	bool "Pad GRUB images to filesystem size (for JFFS2)"
	depends LS_GRUB_IMAGES
	depends TARGET_godson2f_firewall

config LS_GRUB_BAUDRATE
    int "Serial port baud rate"
    depends LS_GRUB_IMAGES
	depends TARGET_godson2f_firewall
    default 115200

config LS_GRUB_KERNELPART
    int "Kernel partition size (in MB)"
    depends LS_GRUB_IMAGES
	depends TARGET_godson2f_firewall
    default 7

config LS_GRUB_ROOTPART
    string
    prompt "Root partition on target device" if LS_GRUB_IMAGES
	depends TARGET_godson2f_firewall
    default "/dev/hda2"
    help
        The root partition on the final device.  If you don't know,
        you probably want the default (/dev/sda2).

config LS_GRUB_BOOTOPTS
    string
    prompt "Extra kernel boot options" if LS_GRUB_IMAGES
	depends TARGET_godson2f_firewall
    default ""
    help
        If you don't know, just leave it blank.


config LS_VDI_IMAGES
    bool "Build VirtualBox image files (VDI). Requires vditool"
	depends TARGET_godson2f_firewall
    depends TARGET_ROOTFS_EXT2FS
    depends LS_GRUB_IMAGES
```
